// SPDX-License-Identifier: GPL-2.0-only
// Definitions for poncha110 camera module on VC I2C bus
/dts-v1/;
/plugin/;

#include <dt-bindings/gpio/gpio.h>
#include "poncha110_mono_color-overlay.dtsi"

&poncha110 {
        compatible = "ams,poncha110";
	reg-name = "poncha110";
};

